## Kconfig.proj
```kconfig
#APP specific configuration.
config CUSTOM_MEM_MAP
    bool
	select custom_mem_map
	default y


select BSP_USING_LCD_FRAMEBUFFER

menu "GBARECOMP runtime"

config GBARECOMP_COMPACT_FRAMEBUFFER
    bool "Compact 240x160 framebuffers (device build)"
    default y
    help
      Compile the two GBA framebuffers into GbaPpu as 240x160 std::array
      instead of allocating the host 1280x864 views on the heap.
      Requires the GBARECOMP_COMPACT_FRAMEBUFFER branch in gba_ppu.h.

config GBARECOMP_NO_HOST_SAMPLER
    bool "Disable the host profiling sampler"
    default y
    help
      Drop the std::thread sampler in runtime_bus_bridge.cpp; neither the
      thread nor its stack is needed on the target.

config GBARECOMP_SMALL_TRACE_RING
    bool "Shrink the runtime trace ring to 64 entries"
    default y
    help
      The 4096-entry RuntimeTraceEntry ring costs 288 KiB of .bss. The
      device keeps a 64-entry tail instead.

config GBARECOMP_NO_HANG_TRACE_DUMP
    bool "Disable the host hang-dump trace export"
    default y
    help
      Drop another 4096 x 72 B static ring plus the CSV export that the
      host writes when it detects a hang.

config GBARECOMP_PSRAM_ALLOC
    bool "Place large cold buffers in PSRAM"
    default y
    help
      Serve the 3.5 MiB audio capture ring and the MP2K shadow ring from the
      4 MiB PSRAM arena in src/gba_psram.c instead of the ~320 KiB on-chip
      heap. Disable only if the board has no external PSRAM.

config GBARECOMP_SMALL_AUDIO_CAPTURE
    bool "Shrink the audio capture ring to 1024 entries"
    default n
    help
      Keep a ~32 ms observability window on targets without PSRAM.
      Enable this when GBARECOMP_PSRAM_ALLOC is off, otherwise the
      capture ring cannot fit in the on-chip heap.

config GBARECOMP_ONCHIP_DISPLAY_MEM
    bool "Keep VRAM/OAM/palette in on-chip SRAM"
    default n
    help
      Bind GbaBus's 96 KB VRAM, 1 KB OAM and 1 KB palette to on-chip SRAM
      instead of the PSRAM arena that holds the rest of the bus. The PPU
      samples them several times per pixel, and each PSRAM load costs a
      round trip plus a D-Cache line evicted by the next access.
      Off by default: measured 5.97 fps against 6.04 fps without it, i.e.
      no gain, because the scanline compositor is compute-bound rather
      than VRAM-bandwidth-bound (344 cycles/pixel versus 14 cycles for an
      on-chip read). It also costs 100 KB of the 178 KB on-chip heap.

config GBARECOMP_PPU_ONCHIP_SCRATCH
    bool "Keep scanline compositor scratch in on-chip SRAM"
    default y
    help
      Move the per-scanline candidate rows, window/coverage masks and the
      RGB888 row buffer out of the scanline compositor's stack into
      file-scope data (on-chip SRAM), and copy the palette once per line.
      They are re-read several times per pixel while VRAM/OAM stream
      through the same 16 KiB D-Cache, so stack copies were being evicted
      and refetched from PSRAM.

config GBARECOMP_PPU_BG_PIXEL_LEAN
    bool "Lean BG per-pixel loop (N3b)"
    default y
    help
      Hoist the vram/palette pointers out of the render_regular_bg lambda
      frame, AND the whole window-control row once per scanline so a layer
      (or the blend bit) enabled on every column drops its per-pixel
      layer_enabled()/blend_enabled() test, and reject transparent color 0
      before the palette load. Bit-identical to the previous loop; disabling
      restores the per-pixel form.

config GBARECOMP_PPU_BG_RUN_BATCH
    bool "Batch BG text sampling over 8-pixel tile runs"
    default y
    help
      Fetch a text BG's map entry and tile byte once per 8-pixel tile run
      instead of once per pixel. Disabling restores the per-pixel form,
      where every pixel repeats the same map fetch.

config GBARECOMP_PPU_BG_ZERO_RUN
    bool "Skip fully transparent 4bpp / 8bpp BG tile runs"
    default y
    help
      Read the four tile bytes of an 8-pixel 4bpp run with one 32-bit load
      (eight bytes / two loads for an 8bpp run). When all of them are zero
      every pixel of the run is color 0 and the per-pixel loop would reject
      it, so the run is skipped as a whole; for 4bpp the same word decodes
      the remaining runs from registers.

config GBARECOMP_PPU_BG_RUN_SKIP
    bool "Skip BG tile runs already covered by a nearer candidate"
    default n
    help
      When no alpha blending is selected and no semi-transparent OBJ touches
      the scanline, a BG tile run whose eight pixels are all already covered
      by a nearer candidate can never reach the output. Drop such runs before
      the map/tile fetch and the per-pixel decode. Disabling restores the
      per-pixel key comparison and submit() call. Off by default: MARIO KART
      draws only ~38% opaque pixels, so an eight-pixel run is fully covered
      about 0.04% of the time and the guard never fires on hardware.

config GBARECOMP_PPU_ROW_WINDOW_CACHE
    bool "Resolve PPU window masks once per scanline"
    default y
    help
      Precompute the 6-bit window mask for the whole row, and skip the
      lookup entirely when no window is enabled, instead of calling
      window_control() for every sampled layer, OBJ pixel and blend test.

config GBARECOMP_PPU_DEFER_RGB
    bool "Expand scanline colors to RGB888 once, at output"
    default y
    help
      Keep the compositor's PixelCandidate rows in GBA 15-bit color and
      convert once in the output pass, instead of caching an rgb[3] triple
      at every submit(). Disabling restores the per-candidate conversion.

config GBARECOMP_PPU_LAZY_HUD_CLEAR
    bool "Skip the unused foreign HUD row clear"
    default y
    help
      Clear and scan the per-layer foreign HUD candidate row only when a
      foreign background is published. Disabling clears it on every
      scanline, as upstream does.

config GBARECOMP_FRAME_SKIP
    bool "Render every other guest frame; present the last complete image"
    default n
    help
      Alternate guest frames skip the scanline compositor, keeping the
      previous complete image on screen. Guest timing, IRQ, DMA and the
      PPU's hidden affine reference accumulators still advance on every
      frame because render_scanline() is still called for each line; only
      the compositor body and the latched-framebuffer copy are dropped.
      The PPU owns the decision (GbaPpu::set_frame_skip(), frame_phase_
      advanced at frame end in tick()); src/gba_device.cpp still presents
      every VBlank so a skipped frame simply repeats the last image.
      Measured on Mario Kart: render 3.46 s -> 1.7-2.1 s per 60 guest
      frames, ~7.2 -> 8.7-10.0 fps, panel at half the guest frame rate.

config GBARECOMP_AUDIO_MUTE
    bool "Mute the guest audio subsystem (skip all audio ticking)"
    default n
    help
      Skip bus->audio().tick() and the audio sample-event constraint in the
      device tick loop, and stop asking audio for its next event in the HALT
      pump. Guest writes to the sound registers still land in the IO array,
      but channel, FIFO and mixer state never advance, so nothing is
      generated or mixed. Measured on Mario Kart: audio accounts for
      386-404 ms per 60 guest frames, ~32% of devtick and ~3.5% of wall.

config GBARECOMP_PERF_PROBES
    bool "Enable the DWT frame-time probes"
    default y
    help
      The [gba] perf/memrd/memwr/lcd/mem-bench instrumentation used to
      locate the frame-rate bottleneck: the frame counters in
      gba_device.cpp, the lcd timing in main.c, and the guest load/store
      split in runtime_bus_bridge.cpp. Turn this off to build without the
      probes.

endmenu
```
